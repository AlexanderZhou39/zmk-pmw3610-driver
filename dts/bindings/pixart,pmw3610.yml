## dts/bindings/pixart,pmw3610.yml
```yaml
description: |
  Sensor driver for the pixart PMW3610 mouse sensor 

compatible: "pixart,pmw3610"

include: spi-device.yaml

properties:
  irq-gpios:
    type: phandle-array
    required: true
  scroll-layer:
    type: int
    default: 3
  snipe-layer:
    type: int
    default: 4
  scroll-snipe-layer:
    type: int
    default: 6
  fast-scroll-layer:
    type: int
    default: 7
  perma-scroll-layer:
    type: int
    default: 8
  automouse-layer:
    type: int
    default: -1
```
